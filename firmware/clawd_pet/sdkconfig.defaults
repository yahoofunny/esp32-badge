## firmware/clawd_pet/sdkconfig.defaults
```kconfig
CONFIG_BOARD_TYPE_WAVESHARE_ESP32_S3_TOUCH_LCD_1_85B=y
CONFIG_USE_WECHAT_MESSAGE_STYLE=n
CONFIG_USE_DEVICE_AEC=y
CONFIG_PARTITION_TABLE_CUSTOM_FILENAME="partitions/clawd-pet.csv"
CONFIG_FLASH_NONE_ASSETS=y
CONFIG_BOOTLOADER_APP_ROLLBACK_ENABLE=n
CONFIG_ESP_CONSOLE_USB_SERIAL_JTAG=y
CONFIG_ESP_CONSOLE_SECONDARY_NONE=y
CONFIG_COMPILER_OPTIMIZATION_PERF=y
```
